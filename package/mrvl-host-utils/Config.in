## package/mrvl-host-utils/Config.in
```kconfig
config BR2_PACKAGE_HOST_MRVL_HOST_UTILS
	depends on BR2_TARGET_ARM_TRUSTED_FIRMWARE || BR2_TARGET_MARVELL_EXTERNAL_FW
	bool "host mrvl-host-utils"
	help
	  Host utilities to work with remote targets

if BR2_PACKAGE_HOST_MRVL_HOST_UTILS

choice
	prompt "mrvl-host-utils-version"
	default BR2_PACKAGE_MRVL_HOST_UTILS_RELEASE

config BR2_PACKAGE_MRVL_HOST_UTILS_CUSTOM_GIT
	bool "Custom Git repository"
	help
	  Allows to specify custom repository for the component
	  Useful for developers building out of bleeding edge sources

config BR2_PACKAGE_MRVL_HOST_UTILS_GIT
	bool "Obtain package from the development GIT"

config BR2_PACKAGE_MRVL_HOST_UTILS_CUSTOM_TARBALL
	bool "Release sources supplied as archives"
	help
	  Use the package sources from local archive

config BR2_PACKAGE_MRVL_HOST_UTILS_RELEASE
	bool "Release archives"
	help
	  Use the package sources specified in this SDK release

endchoice

if BR2_PACKAGE_MRVL_HOST_UTILS_CUSTOM_GIT

config BR2_PACKAGE_MRVL_HOST_UTILS_CUSTOM_REPO_URL
	string "URL of custom repository"

config BR2_PACKAGE_MRVL_HOST_UTILS_CUSTOM_REPO_VERSION
	string "Custom repository version"
	help
	  Revision to use in the typical format used by Git
	  E.G. a sha id, a tag, branch, ..

endif

config BR2_PACKAGE_MRVL_HOST_UTILS_CUSTOM_TARBALL_LOCATION
	string "Name of local archive file with release"

config BR2_PACKAGE_MRVL_HOST_UTILS_VERSION
	string
	default "mrvl-host-utils-sdk11-devel" if BR2_PACKAGE_MRVL_HOST_UTILS_GIT
	default BR2_MARVELL_RELEASE_ID if BR2_PACKAGE_MRVL_HOST_UTILS_CUSTOM_TARBALL
	default BR2_MARVELL_RELEASE_ID if BR2_PACKAGE_MRVL_HOST_UTILS_RELEASE
	default BR2_PACKAGE_MRVL_HOST_UTILS_CUSTOM_REPO_VERSION if BR2_PACKAGE_MRVL_HOST_UTILS_CUSTOM_GIT

config BR2_PACKAGE_MRVL_HOST_UTILS_CN10K
        bool "CN10k socs"
	default n

endif
```

## package/mrvl-mcp-shm/Config.in
```kconfig
config BR2_PACKAGE_MRVL_MCP_SHM
	bool "mrvl-mcp-shm"
	depends on BR2_LINUX_KERNEL
	depends on BR2_TOOLCHAIN_HAS_THREADS # libnl
	select BR2_PACKAGE_LIBOPING
	select BR2_PACKAGE_LIBNL
	select BR2_PACKAGE_INIH
	help
		Marvell share memory kernel module and utils.

if BR2_PACKAGE_MRVL_MCP_SHM

choice
        prompt "mrvl-mcp-shm-version"
        default BR2_PACKAGE_MRVL_MCP_SHM_RELEASE

config BR2_PACKAGE_MRVL_MCP_SHM_GIT
        bool "Obtain package from the development GIT"

config BR2_PACKAGE_MRVL_MCP_SHM_RELEASE
        bool "Release archives"
        help
          Use the package sources specified in this SDK release

endchoice

config BR2_PACKAGE_MRVL_MCP_SHM_VERSION
        string
        default "mrvl-mcp-shm-devel" if BR2_PACKAGE_MRVL_MCP_SHM_GIT
        default BR2_MARVELL_RELEASE_ID if BR2_PACKAGE_MRVL_MCP_SHM_RELEASE

endif
```

## package/musdk-marvell/Config.in
```kconfig
config BR2_PACKAGE_MUSDK_MARVELL
	bool "musdk-marvell"
	help
	  Marvell User-Space SDK (MUSDK) is a light-weight user-space
	  I/O driver for Marvell's Embedded Networking SoC's. The
	  MUSDK library provides a simple and direct access to
	  Marvell's SoC blocks to networking applications and
	  networking infrastructure.

if BR2_PACKAGE_MUSDK_MARVELL

choice
	prompt "musdk-marvell-source"

config BR2_PACKAGE_MUSDK_MARVELL_CUSTOM_GIT
	bool "Custom Git repository"
	help
	  Allows to specify custom repository for the component
	  Useful for developers building out of bleeding edge sources

config BR2_PACKAGE_MUSDK_MARVELL_CUSTOM_TARBALL
	bool "Release sources supplied as archives"
	help
	  Use the package sources from local archive

endchoice

if BR2_PACKAGE_MUSDK_MARVELL_CUSTOM_TARBALL

config BR2_PACKAGE_MUSDK_MARVELL_CUSTOM_TARBALL_LOCATION
	string "URL of custom musdk tarball"
	depends on BR2_PACKAGE_MUSDK_MARVELL_CUSTOM_TARBALL

endif

if BR2_PACKAGE_MUSDK_MARVELL_CUSTOM_GIT

config BR2_PACKAGE_MUSDK_MARVELL_CUSTOM_REPO_URL
	string "Custom repository URL"

config BR2_PACKAGE_MUSDK_MARVELL_CUSTOM_REPO_VERSION
	string "Custom repository version"
	help
	  Revision to use in the typical format used by
	  Git E.G. a sha id, a tag, branch, ..

endif

config BR2_PACKAGE_MUSDK_MARVELL_VERSION
	string
	default BR2_MARVELL_RELEASE_ID if BR2_PACKAGE_MUSDK_MARVELL_CUSTOM_TARBALL
	default BR2_PACKAGE_MUSDK_MARVELL_CUSTOM_REPO_VERSION if BR2_PACKAGE_MUSDK_MARVELL_CUSTOM_GIT

config BR2_PACKAGE_MUSDK_MARVELL_PP2
	bool "pp2"
	help
	  Enable pp2 driver and applications build

config BR2_PACKAGE_MUSDK_MARVELL_NMP
        bool "nmp"
        help
          Enable nmp build

config BR2_PACKAGE_MUSDK_MARVELL_GIU
        bool "giu"
        help
          Enable giu driver build

config BR2_PACKAGE_MUSDK_MARVELL_PP2_LOCK
	bool "pp2 locking"
	depends on BR2_PACKAGE_MUSDK_MARVELL_PP2
	help
	  Enable musdk pp2 driver HIF/TX locking

config BR2_PACKAGE_MUSDK_MARVELL_NETA
	bool "neta"
	help
	  Enable neta driver and applications build

config BR2_PACKAGE_MUSDK_MARVELL_SAM
	bool "sam"
	help
	  Enable musdk sam driver and application build

config BR2_PACKAGE_MUSDK_MARVELL_CUSTOM_OPTS
	string "custom options"
	help
	  Specify additional options that will be passed to musdk's
	  configure script.

config BR2_PACKAGE_MUSDK_MARVELL_FORCE_STATIC_EXAMPLES
	bool "Force static compilation"
	default y
	help
	  MUSDK applications achieve highest performance when they are compiled
	  statically. If enabled, this flag will force MUSDK static library
	  compilation and static linking of examples.

if BR2_LINUX_KERNEL

config BR2_LINUX_KERNEL_EXT_MUSDK_MARVELL
	bool

config BR2_PACKAGE_MUSDK_MARVELL_KERNEL_PATCHES_APPLY
	bool "apply kernel patches"
	select BR2_LINUX_KERNEL_EXT_MUSDK_MARVELL
	help
	  When this option is enabled, the musdk-marvell package will
	  apply its own set of kernel patches. This may work if your
	  kernel version is compatible with the patches provided by
	  musdk-marvell. If not, then keep this option disabled, and
	  make sure to add the relevant kernel patches separately.

if BR2_PACKAGE_MUSDK_MARVELL_KERNEL_PATCHES_APPLY

choice
	prompt "kernel patch series"

config BR2_PACKAGE_MUSDK_MARVELL_KERNEL_PATCHES_LINUX
	bool "linux"

config BR2_PACKAGE_MUSDK_MARVELL_KERNEL_PATCHES_LINUX_4_14
	bool "linux-4.14"

endchoice

endif # BR2_PACKAGE_MUSDK_MARVELL_KERNEL_PATCHES_APPLY

endif # BR2_LINUX_KERNEL

endif # BR2_PACKAGE_MUSDK_MARVELL
```

## package/opencsd/Config.in
```kconfig
config BR2_PACKAGE_OPENCSD
	bool "opencsd"
	help
	  This is having OpenCSD library with a tool to generate
	  intermediate trace data.

if BR2_PACKAGE_OPENCSD

config BR2_PACKAGE_OPENCSD_GIT
	bool "Obtain OpenCSD from GIT"

endif
```

## package/optee/Config.in
```kconfig
config BR2_PACKAGE_OPTEE
	select BR2_PACKAGE_HOST_PYTHON_CRYPTOGRAPHY
	bool "optee"
        help
         Install optee image

if BR2_PACKAGE_OPTEE

choice
        prompt "Optee-version"
        default BR2_PACKAGE_OPTEE_RELEASE

config BR2_PACKAGE_OPTEE_CUSTOM_GIT
        bool "Custom Git repository"
        help
          Allows to specify custom repository for the component
          Useful for developers building out of bleeding edge sources

config BR2_PACKAGE_OPTEE_GIT
        bool "Obtain package from the development GIT"

config BR2_PACKAGE_OPTEE_CUSTOM_TARBALL
        bool "Release sources supplied as archives"
        help
          Use the package sources from local archive

config BR2_PACKAGE_OPTEE_RELEASE
        bool "Release archives"
        help
          Use the package sources specified in this SDK release

endchoice

if BR2_PACKAGE_OPTEE_CUSTOM_GIT

config BR2_PACKAGE_OPTEE_CUSTOM_REPO_URL
        string "URL of custom repository"

config BR2_PACKAGE_OPTEE_CUSTOM_REPO_VERSION
        string "Custom repository version"
        help
          Revision to use in the typical format used by Git
          E.G. a sha id, a tag, branch, ..

endif

config BR2_PACKAGE_OPTEE_CUSTOM_TARBALL_LOCATION
        string "Name of local archive file with release"


config BR2_PACKAGE_OPTEE_VERSION
        string
        default "optee-os-3.22.0-devel" if BR2_PACKAGE_OPTEE_GIT
        default BR2_MARVELL_RELEASE_ID if BR2_PACKAGE_OPTEE_CUSTOM_TARBALL
        default BR2_MARVELL_RELEASE_ID if BR2_PACKAGE_OPTEE_RELEASE
        default BR2_PACKAGE_OPTEE_CUSTOM_REPO_VERSION if BR2_PACKAGE_OPTEE_CUSTOM_GIT

endif
```

## package/schedtool/Config.in
```kconfig
config BR2_PACKAGE_SCHEDTOOL
	bool "schedtool"
	help
	  schedtool was born, because there was no tool to change or
	  query all CPU-scheduling policies under Linux, in one handy
	  command.  Support for CPU-affinity has also been added and
	  most recently (re-)nicing of processes.

	  Thus, schedtool is the definitive interface to Linux's scheduler.

	  https://github.com/freequaos/schedtool
```

## package/serdes-cli/Config.in
```kconfig
config BR2_PACKAGE_SERDES_CLI
	bool "serdes-cli"
	help
	  This is a CSR tool to read and write CSR/System registers from
	  linux shell on OcteonTX/OcteonTX2 boards

if BR2_PACKAGE_SERDES_CLI

choice
	prompt "serdes-cli-version"
	default BR2_PACKAGE_SERDES_CLI_RELEASE

config BR2_PACKAGE_SERDES_CLI_GIT
	bool "Obtain package from the development GIT"

config BR2_PACKAGE_SERDES_CLI_RELEASE
	bool "Release archives"
	help
	  Use the package sources specified in this SDK release

endchoice

config SERDES_CLI_NAME_BIN
	string
	default "serdes-cli-cn10k" if BR2_PACKAGE_SERDES_CLI_CN10K
	default "serdes-cli" if BR2_PACKAGE_SERDES_CLI_CN9K

config BR2_PACKAGE_SERDES_CLI_CN9K
	bool "For octeontx2 SoC's"

config BR2_PACKAGE_SERDES_CLI_CN10K
	bool "For cn10k SoC's"

config BR2_PACKAGE_SERDES_CLI_VERSION
	string
	default "cli-cn10k-devel" if BR2_PACKAGE_SERDES_CLI_GIT && BR2_PACKAGE_SERDES_CLI_CN10K
	default "cli-t9x-devel" if BR2_PACKAGE_SERDES_CLI_GIT && BR2_PACKAGE_SERDES_CLI_CN9K
	default BR2_MARVELL_RELEASE_ID if BR2_PACKAGE_SERDES_CLI_CUSTOM_TARBALL
	default BR2_MARVELL_RELEASE_ID if BR2_PACKAGE_SERDES_CLI_RELEASE
	default BR2_PACKAGE_SERDES_CLI_CUSTOM_REPO_VERSION if BR2_PACKAGE_SERDES_CLI_CUSTOM_GIT

endif
```

## package/spdk/Config.in
```kconfig
config BR2_PACKAGE_SPDK
	bool "spdk"
	depends on BR2_PACKAGE_DPDK
	help
	  Install spdk package into the filesystem.

if BR2_PACKAGE_SPDK

config BR2_PACKAGE_SPDK_CUSTOM_GIT
	bool "Obtain SPDK from GIT"

config BR2_PACKAGE_SPDK_CUSTOM_ARCHIVE
	bool "Obtain SPDK from TAR ball"

if BR2_PACKAGE_SPDK_CUSTOM_GIT

config BR2_PACKAGE_SPDK_CUSTOM_REPO_URL
	string "SPDK repository URL"

config BR2_PACKAGE_SPDK_CUSTOM_REPO_VERSION
	string "SPDK repository version"

endif

if BR2_PACKAGE_SPDK_CUSTOM_ARCHIVE

config BR2_PACKAGE_SPDK_CUSTOM_ARCHIVE_LOCATION
        string "URL of custom spdk archive"
        depends on BR2_PACKAGE_SPDK_CUSTOM_ARCHIVE

endif

config BR2_PACKAGE_SPDK_WITH_RDMA
	bool "spdk-with-rdma"

endif
```

## package/txcsr/Config.in
```kconfig
config BR2_PACKAGE_TXCSR
	bool "txcsr"
	help
	  This is a CSR tool to read and write CSR/System registers from
	  linux shell on OcteonTX/OcteonTX2 boards

if BR2_PACKAGE_TXCSR

choice
	prompt "libpmt-version"
	default BR2_PACKAGE_TXCSR_RELEASE

config BR2_PACKAGE_TXCSR_CUSTOM_GIT
	bool "Custom Git repository"
	help
	  Allows to specify custom repository for the component
	  Useful for developers building out of bleeding edge sources

config BR2_PACKAGE_TXCSR_GIT
	bool "Obtain package from the development GIT"

config BR2_PACKAGE_TXCSR_CUSTOM_TARBALL
	bool "Release sources supplied as archives"
	help
	  Use the package sources from local archive

config BR2_PACKAGE_TXCSR_RELEASE
	bool "Release archives"
	help
	  Use the package sources specified in this SDK release

endchoice

if BR2_PACKAGE_TXCSR_CUSTOM_GIT

config BR2_PACKAGE_TXCSR_CUSTOM_REPO_URL
	string "URL of custom repository"

config BR2_PACKAGE_TXCSR_CUSTOM_REPO_VERSION
	string "Custom repository version"
	help
	  Revision to use in the typical format used by Git
	  E.G. a sha id, a tag, branch, ..

endif

config BR2_PACKAGE_TXCSR_CUSTOM_TARBALL_LOCATION
	string "Name of local archive file with release"

config BR2_PACKAGE_TXCSR_VERSION
	string
	default "txcsr-sdk11-devel" if BR2_PACKAGE_TXCSR_GIT
	default BR2_MARVELL_RELEASE_ID if BR2_PACKAGE_TXCSR_CUSTOM_TARBALL
	default BR2_MARVELL_RELEASE_ID if BR2_PACKAGE_TXCSR_RELEASE
	default BR2_PACKAGE_TXCSR_CUSTOM_REPO_VERSION if BR2_PACKAGE_TXCSR_CUSTOM_GIT

endif
```

## package/zephyr/Config.in
```kconfig
config BR2_PACKAGE_HOST_ZEPHYR
	bool "zephyr"
	select BR2_PACKAGE_PYTHON_WEST
	help
	  This is Zephyr OS
	  
```
