## Config.in
```kconfig
config BR2_MARVELL_RELEASE_ID
	string "marvell-release-id"
	help
	  The release ID that used in Marvell release archive names

config BR2_MARVELL_SDK13
        bool "marvell-sdk-version"
        default y
        help
          Marvell SDK version

config BR2_HOST_IS_OCTEON
        bool "Octeon-is-host"
        default n
        help
          Octeon SoC is the host

config BR2_MARVELL_CN10K_A0
        bool "marvell-sdk-version"
        help
          Marvell SDK version

config BR2_MARVELL_SOC_FAMILY
        string "MV SoC family: ARMADA3K | ARMADA | OCTEONTX | OCTEONTX2 | CN10K"
        help
          SoC family string: ARMADA3K | ARMADA | OCTEONTX | OCTEONTX2 | CN10K

config BR2_MARVELL_DEBUG_ACCESS_SECURE
        bool "marvell-access-secure"
        help
          Marvell debug build with access secure patches

choice
	prompt "Target install base"
	help
	  Select the target platform-dependent installation base

config BR2_MARVELL_CUSTOM_TARGET_INSTALL_BASE
	bool "use custom target platform-dependent installation directory"

config BR2_MARVELL_DEFAULT_TARGET_INSTALL_BASE
	bool "/usr/marvell"

endchoice

if BR2_MARVELL_CUSTOM_TARGET_INSTALL_BASE

config BR2_MARVELL_CUSTOM_TARGET_INSTALL_BASE_DIR
	string "custom target platform-dependent installation directory location"
endif

config BR2_MARVELL_TARGET_INSTALL_BASE
	string
	default "/usr/marvell" if BR2_MARVELL_DEFAULT_TARGET_INSTALL_BASE
	default BR2_MARVELL_CUSTOM_TARGET_INSTALL_BASE_DIR if BR2_MARVELL_CUSTOM_TARGET_INSTALL_BASE

source "$BR2_EXTERNAL_MARVELL_SDK_PATH/boot/uefi/Config.in"
source "$BR2_EXTERNAL_MARVELL_SDK_PATH/boot/marvell-external-fw/Config.in"
source "$BR2_EXTERNAL_MARVELL_SDK_PATH/package/libtmc/Config.in"
source "$BR2_EXTERNAL_MARVELL_SDK_PATH/package/schedtool/Config.in"
source "$BR2_EXTERNAL_MARVELL_SDK_PATH/package/cpt-microcode/Config.in"
source "$BR2_EXTERNAL_MARVELL_SDK_PATH/package/cavium-ipfwd-offload/Config.in"
source "$BR2_EXTERNAL_MARVELL_SDK_PATH/package/cavium-xdp-ipfwd/Config.in"
source "$BR2_EXTERNAL_MARVELL_SDK_PATH/package/build-test/Config.in"
source "$BR2_EXTERNAL_MARVELL_SDK_PATH/package/libpmt/Config.in"
source "$BR2_EXTERNAL_MARVELL_SDK_PATH/package/txcsr/Config.in"
source "$BR2_EXTERNAL_MARVELL_SDK_PATH/package/serdes-cli/Config.in"
source "$BR2_EXTERNAL_MARVELL_SDK_PATH/package/gator/Config.in"
source "$BR2_EXTERNAL_MARVELL_SDK_PATH/package/zephyr/Config.in"
source "$BR2_EXTERNAL_MARVELL_SDK_PATH/package/dpdk/Config.in"
source "$BR2_EXTERNAL_MARVELL_SDK_PATH/package/dpdk-crypto/Config.in"
source "$BR2_EXTERNAL_MARVELL_SDK_PATH/package/mrvl-host-utils/Config.in"
source "$BR2_EXTERNAL_MARVELL_SDK_PATH/package/musdk-marvell/Config.in"
source "$BR2_EXTERNAL_MARVELL_SDK_PATH/package/is_fw/Config.in"
source "$BR2_EXTERNAL_MARVELL_SDK_PATH/package/memutils/Config.in"
source "$BR2_EXTERNAL_MARVELL_SDK_PATH/package/opencsd/Config.in"
source "$BR2_EXTERNAL_MARVELL_SDK_PATH/package/ovs/Config.in"
source "$BR2_EXTERNAL_MARVELL_SDK_PATH/package/asim/Config.in"
source "$BR2_EXTERNAL_MARVELL_SDK_PATH/package/mrvl-mcp-shm/Config.in"
source "$BR2_EXTERNAL_MARVELL_SDK_PATH/package/optee/Config.in"
source "$BR2_EXTERNAL_MARVELL_SDK_PATH/package/asimcp/Config.in"
source "$BR2_EXTERNAL_MARVELL_SDK_PATH/package/spdk/Config.in"
source "$BR2_EXTERNAL_MARVELL_SDK_PATH/package/mrvl-utils/Config.in"
source "$BR2_EXTERNAL_MARVELL_SDK_PATH/package/cti/Config.in"
source "$BR2_EXTERNAL_MARVELL_SDK_PATH/package/socinsight/Config.in"
source "$BR2_EXTERNAL_MARVELL_SDK_PATH/package/libcnxk-debug/Config.in"
source "$BR2_EXTERNAL_MARVELL_SDK_PATH/package/libipsec-mb/Config.in"
source "$BR2_EXTERNAL_MARVELL_SDK_PATH/boot/marvell-external-fw/extension-packages/python-pyyaml-include/Config.in"
```

## board/marvell/fit/dummy/default.its
```
/* Cavium Thunder flattened image tree source
 *
 * SPDX-License-Identifier:           BSD-3-Clause
 * https://spdx.org/licenses
 * Copyright (c) 2023 Marvell.
 */

/dts-v1/;

/ {
	description = "Dummy file for signing board .dtb files";
	#address-cells = <1>;

	images {
		/* kernel-1 is the name of the first and only kernel in this
		 * image.
		 */
		kernel {
			/* Description for this kernel */
			description = "dummy kernel image";

			/* Location of the kernel image to be used for "kernel-1" */
			data = /incbin/("dummy.bin");

			/* Type of image, must be "kernel" */
			type = "kernel";

			/* Architecture, must be "arm64"" */
			arch = "arm64";

			/* operating system, must be "linux" */
			os = "linux";

			/* Type of compression used, for zImage set to none.
			 * If compressed to gzip so it is zImage.gz then set
			 * to gzip.
			 */
			compression = "none";

			/* Load address for the kernel, this must be set to
			 * $kernel_addr
			 */
			load = <0x40080000>;

			/* entry address, currently the same as the load address
			 */
			entry = <0x40080000>;

			/* First hash used to verify the integrity of the image.
			 *
			 * Multiple hash types can be used by adding sections
			 * hash-2, etc.
			 */
			hash-1 {
				/* Algorithm used to verify the image integrity.
				 * This can be crc32, md5, sha1 or sha256.
				 */
				algo = "sha256";
			};
			/* signature section for signing the kernel image
			 *
			 * Multiple signatures can be added, i.e. signature-1,
			 * signature-2, etc.  As long as one matches the kernel
			 * will be authenticated.
			 */
			signature-1 {
				/* Signature algorithm */
				algo = "sha256,rsa2048";

				/* Name of key file to use, i.e.
				 * dev.crt and dev.key
				 */
				key-name-hint = "dev";
			};
		};
	};
	configurations {
		/* default configuration to use if not specified */
		default = "config-1";

		/* First configuration */
		config-1 {
			/* configuration for a particular kernel and root
			 * filesystem pair.
			 */
			description = "OcteonTX/Thunder Linux configuration";

			/* kernel image to use */
			kernel = "kernel";

			/* First signature of configuration for development */
			signature-1 {
				/* signature algorithm to use for configuration
				 */
				algo = "sha256,rsa2048";
				/* signature key filename */
				key-name-hint = "dev";
				/* images that are signed */
				sign-images = "kernel";
			};
		};
	};
};
```

## board/marvell/fit/templates/one-kernel-one-rootfs.its
```
/* Cavium Thunder flattened image tree source
 *
 * SPDX-License-Identifier:           BSD-3-Clause
 * https://spdx.org/licenses
 * Copyright (c) 2017 Marvell.
 */

/dts-v1/;

/ {
	description = "Image for Cavium OcteonTX with Linux Kernel and ramdisk";
	#address-cells = <1>;

	images {
		/* kernel@1 is the name of the first and only kernel in this
		 * image.
		 */
		kernel@1 {
			/* Description for this kernel */
			description = "Cavium OcteonTX/Thunder Linux Kernel";

			/* Location of the kernel image to be used for "kernel@1" */
			data = /incbin/("../../linux/kernel/linux/arch/arm64/boot/Image");

			/* Type of image, must be "kernel" */
			type = "kernel";

			/* Architecture, must be "arm64"" */
			arch = "arm64";

			/* operating system, must be "linux" */
			os = "linux";

			/* Type of compression used, for zImage set to none.
			 * If compressed to gzip so it is zImage.gz then set
			 * to gzip.
			 */
			compression = "none";

			/* Load address for the kernel, this must be set to
			 * $kernel_addr
			 */
			load = <0x40080000>;

			/* entry address, currently the same as the load address
			 */
			entry = <0x40080000>;

			/* First hash used to verify the integrity of the image.
			 *
			 * Multiple hash types can be used by adding sections
			 * hash@2, etc.
			 */
			hash@1 {
				/* Algorithm used to verify the image integrity.
				 * This can be crc32, md5, sha1 or sha256.
				 */
				algo = "sha256";
			};
			/* signature section for signing the kernel image
			 *
			 * Multiple signatures can be added, i.e. signature@1,
			 * signature@2, etc.  As long as one matches the kernel
			 * will be authenticated.
			 */
			signature@1 {
				/* Signature algorithm */
				algo = "sha256,rsa2048";

				/* Name of key file to use, i.e.
				 * dev.crt and dev.key
				 */
				key-name-hint = "dev";
			};
		};

		/* Ramdisk image for root filesystem */
		ramdisk@1 {
			/* Description of ramdisk */
			description = "Cavium OcteonTX/Thunder Linux ramdisk";

			/* Location of ramdisk file to use */
			data = /incbin/("../../linux/cavium-rootfs/initramfs.cpio.lz4");

			/* Type of data, must be "ramdisk" for cpio data */
			type = "ramdisk";

			/* Architecture, must be "arm64" */
			arch = "arm64";

			/* Operating system, must be "linux" */
			os = "linux";

			/* Compression used, for a .lz4 file this should be
			 * "lz4".
			 * Supported formats are bzip2, gzip, lzma, lzo and lz4.
			 */
			compression = "lz4";

			/* Load address, should be past the kernel */
			load = <0x48080000>;

			/* Entry isn't really used for ramdisk, set same as
			 * load address.
			 */
			entry = <0x48080000>;

			/* First hash used to verify the ramfs image */
			hash@1 {
				/* Integrity hash algorithm */
				algo = "sha256";
			};

			/* First signature of ramfs for development */
			signature@1 {
				/* signature algorithm */
				algo = "sha256,rsa2048";

				/* signature key filename */
				key-name-hint = "dev";
			};
		};
	};
	configurations {
		/* default configuration to use if not specified */
		default = "config@1";

		/* First configuration */
		config@1 {
			/* configuration for a particular kernel and root
			 * filesystem pair.
			 */
			description = "OcteonTX/Thunder Linux configuration";

			/* kernel image to use */
			kernel = "kernel@1";

			/* ramdisk image to use */
			ramdisk = "ramdisk@1";

			/* First signature of configuration for development */
			signature@1 {
				/* signature algorithm to use for configuration
				 */
				algo = "sha256,rsa2048";
				/* signature key filename */
				key-name-hint = "dev";
				/* images that are signed */
				sign-images = "kernel", "ramdisk";
			};
		};
	};
};
```

## board/marvell/fit/templates/one-rootfs.its
```
/* Cavium Thunder flattened image tree source
 *
 * SPDX-License-Identifier:           BSD-3-Clause
 * https://spdx.org/licenses
 * Copyright (c) 2017 Marvell.
 */

/dts-v1/;

/ {
	description = "Image for Cavium OcteonTX with Linux Kernel and ramdisk";
	#address-cells = <1>;

	images {
		/* Ramdisk image for root filesystem */
		ramdisk@1 {
			/* Description of ramdisk */
			description = "Cavium OcteonTX/Thunder Linux ramdisk";

			/* Location of ramdisk file to use */
			data = /incbin/("../../linux/cavium-rootfs/initramfs.cpio.lz4");

			/* Type of data, must be "ramdisk" for cpio data */
			type = "ramdisk";

			/* Architecture, must be "arm64" */
			arch = "arm64";

			/* Operating system, must be "linux" */
			os = "linux";

			/* Compression used, for a .lz4 file this should be
			 * "lz4".
			 * Supported formats are bzip2, gzip, lzma, lzo and lz4.
			 */
			compression = "lz4";

			/* Load address, should be past the kernel */
			load = <0x48080000>;

			/* Entry isn't really used for ramdisk, set same as
			 * load address.
			 */
			entry = <0x48080000>;

			/* First hash used to verify the ramfs image */
			hash@1 {
				/* Integrity hash algorithm */
				algo = "sha256";
			};

			/* First signature of ramfs for development */
			signature@1 {
				/* signature algorithm */
				algo = "sha256,rsa2048";

				/* signature key filename */
				key-name-hint = "dev";
			};
		};
	};
	configurations {
		/* default configuration to use if not specified */
		default = "config@1";

		/* First configuration */
		config@1 {
			/* configuration for a particular kernel and root
			 * filesystem pair.
			 */
			description = "OcteonTX/Thunder Linux configuration";

			/* ramdisk image to use */
			ramdisk = "ramdisk@1";

			/* First signature of configuration for development */
			signature@1 {
				/* signature algorithm to use for configuration
				 */
				algo = "sha256,rsa2048";
				/* signature key filename */
				key-name-hint = "dev";
				/* images that are signed */
				sign-images = "ramdisk";
			};
		};
	};
};
```
