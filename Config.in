## package/cti/Config.in
```kconfig
config BR2_PACKAGE_CTI
	bool "cti"
	depends on BR2_PACKAGE_DPDK
	help
	  Common transport apps and libraries for pcie endpoints.

if BR2_PACKAGE_CTI
choice
	prompt "cti version"
	help
	  Select the specific version you want to use
	default BR2_PACKAGE_CTI_CUSTOM_GIT

config BR2_PACKAGE_CTI_CUSTOM_GIT
	bool "Custom Git repository"
	help
	  Allows to specify custom repository for the component
	  Useful for developers building out of bleeding edge sources

config BR2_PACKAGE_CTI_CUSTOM_ARCHIVE
	bool "Custom archive"
	help
	  This option allows to specify a URL pointing to a cti
	  source archive. This URL can use any protocol recognized by
	  Buildroot, like http://, ftp://, file:// or scp://.

	  When pointing to a local archive using file://, you may want
	  to use a make variable like $(TOPDIR) to reference the root of
	  the Buildroot tree.

endchoice

if BR2_PACKAGE_CTI_CUSTOM_GIT

config BR2_PACKAGE_CTI_CUSTOM_REPO_URL
	string "Custom repository URL"

config BR2_PACKAGE_CTI_CUSTOM_REPO_VERSION
	string "Custom repository version"
	help
	  Revision to use in the typical format used by Git
	  e.g. a SHA1 id or a tag.

endif

if BR2_PACKAGE_CTI_CUSTOM_ARCHIVE

config BR2_PACKAGE_CTI_CUSTOM_ARCHIVE_LOCATION
	string "URL of custom cti archive"
	depends on BR2_PACKAGE_CTI_CUSTOM_ARCHIVE

endif

config BR2_PACKAGE_CTI_VERSION
	string
	default BR2_PACKAGE_CTI_CUSTOM_REPO_VERSION if BR2_PACKAGE_CTI_CUSTOM_GIT

endif # BR2_PACKAGE_CTI
```

## package/dpdk-crypto/Config.in
```kconfig
config BR2_PACKAGE_DPDK_CRYPTO
	bool "dpdk-crypto"
	help
	  DPDK crypto library

if BR2_PACKAGE_DPDK_CRYPTO

config BR2_PACKAGE_DPDK_CRYPTO_GIT
	bool "Obtain dpdk crypto from GIT"

endif
```

## package/dpdk/Config.in
```kconfig
config BR2_PACKAGE_DPDK_ARCH_SUPPORTS
	bool
	depends on BR2_TOOLCHAIN_HAS_SYNC_1 && \
		BR2_TOOLCHAIN_HAS_SYNC_2 && \
		BR2_TOOLCHAIN_HAS_SYNC_4 && \
		BR2_TOOLCHAIN_HAS_SYNC_8
	default y if (BR2_i386 && !BR2_x86_i386 && !BR2_x86_i486 \
			&& !BR2_x86_i586 && !BR2_x86_x1000)
	default y if BR2_x86_64
	default y if BR2_ARM_CPU_ARMV7A
	default y if BR2_aarch64 || BR2_aarch64_be

comment "dpdk needs a glibc toolchain and a Linux Kernel to be built"
	depends on BR2_PACKAGE_DPDK_ARCH_SUPPORTS
	depends on !BR2_TOOLCHAIN_USES_GLIBC || !BR2_LINUX_KERNEL

config BR2_PACKAGE_DPDK
	bool "dpdk"
	depends on BR2_PACKAGE_DPDK_ARCH_SUPPORTS
	depends on BR2_TOOLCHAIN_USES_GLIBC
	depends on BR2_LINUX_KERNEL
	select BR2_LINUX_NEEDS_MODULES
	select BR2_PACKAGE_PYTHON_PYELFTOOLS
	help
	  DPDK is a set of libraries and drivers for fast packet
	  processing. It was designed to run on any processors,
	  however, Intel x86 has been the first CPU to be
	  supported. Ports for other CPUs like IBM Power 8 and ARM are
	  under progress. It runs mostly in Linux userland. A FreeBSD
	  port is now available for a subset of DPDK features.

	  Notes:
	  * To build the included Linux Kernel drivers, it is
	    necessary to enable CONFIG_PCI_MSI, CONFIG_UIO.
	  * To build the PCAP PMD properly, you need to enable the
	    libpcap manually.
	  * You may need to install the python2 interpreter if you
	    want to use scripts dpdk_nic_bind.py and cpu_layout.py

	  http://www.dpdk.org/

if BR2_PACKAGE_DPDK

choice
	prompt "DPDK Version"
	help
	  Select the specific DPDK version you want to use

config BR2_PACKAGE_DPDK_LATEST_VERSION
	bool "18.11"

config BR2_PACKAGE_DPDK_CUSTOM_GIT
	bool "Custom Git repository"

config BR2_PACKAGE_DPDK_CUSTOM_ARCHIVE
	bool "Custom archive"
	help
	  This option allows to specify a URL pointing to a dpdk
	  source archive. This URL can use any protocol recognized by
	  Buildroot, like http://, ftp://, file:// or scp://.

	  When pointing to a local archive using file://, you may want
	  to use a make variable like $(TOPDIR) to reference the root of
	  the Buildroot tree.

endchoice

if BR2_PACKAGE_DPDK_CUSTOM_GIT

config BR2_PACKAGE_DPDK_CUSTOM_REPO_URL
	string "Custom repository URL"

config BR2_PACKAGE_DPDK_CUSTOM_REPO_VERSION
	string "Custom repository version"
	help
	  Revision to use in the typical format used by Git, e.g a
	  SHA1 id or a tag.

endif # BR2_PACKAGE_DPDK_CUSTOM_GIT

if BR2_PACKAGE_DPDK_CUSTOM_ARCHIVE

config BR2_PACKAGE_DPDK_CUSTOM_ARCHIVE_LOCATION
	string "URL of custom dpdk archive"
	depends on BR2_PACKAGE_DPDK_CUSTOM_ARCHIVE

endif

config BR2_PACKAGE_DPDK_VERSION
	string
	default "18.11" if BR2_PACKAGE_DPDK_LATEST_VERSION
	default BR2_PACKAGE_DPDK_CUSTOM_REPO_VERSION if BR2_PACKAGE_DPDK_CUSTOM_GIT

config BR2_PACKAGE_DPDK_PLATFORM_OCTEONTX2
	bool "OcteonTX2"
	help
	  For OcteonTX2 SoC family.

config BR2_PACKAGE_DPDK_PLATFORM_OCTEONTX
	bool "Octeon TX1"
	help
	  Octeon TX1 SoC family.

config BR2_PACKAGE_DPDK_PLATFORM_CN10K
	bool "cn10k"
	help
	  For Cn10k SoCs

config BR2_PACKAGE_DPDK_PLATFORM_CN20K
        bool "cn20k"
        help
          For Cn20k SoCs

config BR2_PACKAGE_DPDK_NO_LIBPCAP
	bool "pcap-lib do not use"
	help
	  Force don't use pcap library

config BR2_PACKAGE_DPDK_CONFIG
	string "Configuration"
	default "arm64_armada_linux_gcc" \
		if BR2_PACKAGE_MUSDK_MARVELL
	default "arm64_cn9k_linux_gcc" \
		if BR2_PACKAGE_DPDK_PLATFORM_OCTEONTX2
	default "arm64_thunderxt83_linux_gcc" \
		if BR2_PACKAGE_DPDK_PLATFORM_OCTEONTX
	default "arm64_cn10k_linux_gcc" \
		if BR2_PACKAGE_DPDK_PLATFORM_CN10K
	default "arm64_cn20k_linux_gcc" \
                if BR2_PACKAGE_DPDK_PLATFORM_CN20K
	default "i686-native-linuxapp-gcc" \
		if BR2_x86_i686
	default "x86_64-native-linuxapp-gcc" \
		if BR2_x86_64
	default "arm-armv7a-linuxapp-gcc" \
		if BR2_ARM_CPU_ARMV7A
	default "arm64-armv8a-linuxapp-gcc" \
		if BR2_aarch64 || BR2_aarch64_be

config BR2_PACKAGE_DPDK_SHARED_LIB
	bool "Enable DPDK shared library"
	default n
	help
	  Compile DPDK as shared library so other packages can link to it;
	  e.g. ODP over DPDK combination.

config BR2_PACKAGE_DPDK_ENABLE_FPIC
	bool
	default n
	prompt "Enable -fPIC for dpdk static library"
	help
	  "Pass CPU_CFLAGS=-fPIC in dpdk make command"

config BR2_PACKAGE_DPDK_REDUCED_FOOTPRINT
	bool
	default n
	prompt "Use smaller applications and examples set"
	help
	  "Use smaller applications and examples set on target file system"

config BR2_PACKAGE_DPDK_WITHOUT_EXAMPLES
        bool
        default n
        prompt "Dont Copy examples to rootfs"
        help
          "Dont copy examples to target file system"


config BR2_PACKAGE_DPDK_DEBUG_BUILD
	bool
	default n
	prompt "Generate DPDK for debugging."
	help
	  "Useful for source-level debugging of DPDK (with gdb)."

endif # BR2_PACKAGE_DPDK
```

## package/gator/Config.in
```kconfig
config BR2_PACKAGE_GATOR
	bool "gator"
	help
	  This is Gator daemon, driver and related tools. A target agent (gator)
	  is required to run on the Arm Linux target in order for Arm Streamline
	  to operate.

if BR2_PACKAGE_GATOR

choice
	prompt "libpmt-version"
	default BR2_PACKAGE_GATOR_GIT

config BR2_PACKAGE_GATOR_GIT
	bool "Obtain package from the development GIT"

endchoice

config BR2_PACKAGE_GATOR_VERSION
	string
	default "7.7.0" if BR2_PACKAGE_GATOR_GIT
endif
```

## package/is_fw/Config.in
```kconfig
config BR2_PACKAGE_IS_FW
	bool "is_fw"
	help
	  Firmware for eip197 crypto accelerator

if BR2_PACKAGE_IS_FW

choice
	bool "is_fw-version"
	default BR2_PACKAGE_IS_FW_RELEASE

config BR2_PACKAGE_IS_FW_CUSTOM_GIT
	prompt "Custom Git repository"
	help
	  Allows to specify custom repository for the component
	  Useful for developers building out of bleeding edge sources

config BR2_PACKAGE_IS_FW_GIT
	bool "Obtain package from the development GIT"

config BR2_PACKAGE_IS_FW_CUSTOM_TARBALL
	bool "Release sources supplied as archives"
	help
	  Use the package sources from local archive

config BR2_PACKAGE_IS_FW_RELEASE
	bool "Release archives"
	help
	  Use the package sources specified in this SDK release

endchoice

if BR2_PACKAGE_IS_FW_CUSTOM_GIT

config BR2_PACKAGE_IS_FW_CUSTOM_REPO_URL
	string "URL of custom repository"

config BR2_PACKAGE_IS_FW_CUSTOM_REPO_VERSION
	string "Custom repository version"
	help
	  Revision to use in the typical format used by Git
	  E.G. a sha id, a tag, branch, ..

endif

config BR2_PACKAGE_IS_FW_CUSTOM_TARBALL_LOCATION
	string "Name of local archive file with release"

config BR2_PACKAGE_IS_FW_VERSION
	string
	default "is_fw-devel" if BR2_PACKAGE_IS_FW_GIT
	default BR2_MARVELL_RELEASE_ID if BR2_PACKAGE_IS_FW_CUSTOM_TARBALL
	default BR2_MARVELL_RELEASE_ID if BR2_PACKAGE_IS_FW_RELEASE
	default BR2_PACKAGE_IS_FW_CUSTOM_REPO_VERSION if BR2_PACKAGE_IS_FW_CUSTOM_GIT


endif
```

## package/libcnxk-debug/Config.in
```kconfig
config BR2_PACKAGE_LIBCNXK_DEBUG
	bool "libcnxk-debug"
	select BR2_PACKAGE_JANSSON
	select BR2_PACKAGE_CUNIT
	select BR2_PACKAGE_LIBUNWIND
	select BR2_PACKAGE_LIBMICROHTTPD
	help
	  CNXK debug library

if BR2_PACKAGE_LIBCNXK_DEBUG

choice
	prompt "libcnxk-debug Version"
	help
	  Select the specific libcnxk-debug version you want to use

config BR2_PACKAGE_LIBCNXK_DEBUG_CUSTOM_GIT
	bool "Custom Git repository"

	help
	  Force to specified Custom Git repository

config BR2_PACKAGE_LIBCNXK_DEBUG_CUSTOM_ARCHIVE
	bool "Custome archive"
	help
	  This option allows to specify a URL pointing to a libcnxk-debug
	  source archive. This URL can use any protocol recognized by
	  Buildroot, like http://, ftp://, file:// or scp://.

	  When pointing to a local archive using file://, you may want
	  to use a make variable like $(TOPDIR) to reference the root of
	  the Buildroot tree.

endchoice

if BR2_PACKAGE_LIBCNXK_DEBUG_CUSTOM_GIT
config BR2_PACKAGE_LIBCNXK_DEBUG_CUSTOM_REPO_URL
	string "Custom repository URL"

config BR2_PACKAGE_LIBCNXK_DEBUG_CUSTOM_REPO_VERSION
	string "Custom repository version"
	help
	  Revision to use in the typical format used by Git,
	  e.g. branch-name or hash-id.
endif

if BR2_PACKAGE_LIBCNXK_DEBUG_CUSTOM_ARCHIVE
config BR2_PACKAGE_LIBCNXK_DEBUG_CUSTOM_ARCHIVE_LOCATION
	string "URL of custom libcnxk-debug archive"
	depends on BR2_PACKAGE_LIBCNXK_DEBUG_CUSTOM_ARCHIVE
endif


choice
	prompt "Target Platform"
	help
	  Choose platform for which to build and install libcnxk-debug library and
	  examples.


config BR2_PACKAGE_LIBCNXK_DEBUG_PLATFORM_CN10K
	bool "cn10k"
	help
	  For CN10K SoC family and using ONA blocks.

config BR2_PACKAGE_LIBCNXK_DEBUG_PLATFORM_CN9K
	bool "cn9k"
	help
	  For CN9XX SoC family and using ONA blocks.

endchoice

config BR2_PACKAGE_LIBCNXK_DEBUG_PLATFORM
	string
	default "cn10k" if BR2_PACKAGE_LIBCNXK_DEBUG_PLATFORM_CN10K
	default "cn9k" if BR2_PACKAGE_LIBCNXK_DEBUG_PLATFORM_CN9K

config BR2_PACKAGE_LIBCNXK_DEBUG_VERSION
        string
        default BR2_PACKAGE_LIBCNXK_DEBUG_CUSTOM_REPO_VERSION if BR2_PACKAGE_LIBCNXK_DEBUG_CUSTOM_GIT
        default BR2_MARVELL_RELEASE_ID if BR2_PACKAGE_LIBCNXK_DEBUG_CUSTOM_ARCHIVE

endif
```

## package/libipsec-mb/Config.in
```kconfig
config BR2_PACKAGE_LIBIPSEC_MB
	bool "libipsec-mb"
	default n
	help
		The library provides software crypto acceleration primarily targeting packet processing applications. It can be used for application such as: IPsec, TLS, Wireless (RAN), Cable or MPEG DRM.
		The library is used as software crypto provider in DPDK, Intel(R) QAT Engine and FD.io.

config BR2_PACKAGE_LIBIPSEC_MB_VERSION
        string "version-id"
```

## package/libpmt/Config.in
```kconfig
config BR2_PACKAGE_LIBPMT
	bool "libpmt"
	help
	  This is a small C static library focused on providing
	  low-latency tracing for ARMv8 applications. Each trace
	  is identified by an application defined trace ID and
	  contains value of the PMU Cycle Counter register (PMCCNTR).

if BR2_PACKAGE_LIBPMT

choice
	prompt "libpmt-version"
	default BR2_PACKAGE_LIBPMT_RELEASE

config BR2_PACKAGE_LIBPMT_CUSTOM_GIT
	bool "Custom Git repository"
	help
	  Allows to specify custom repository for the component
	  Useful for developers building out of bleeding edge sources

config BR2_PACKAGE_LIBPMT_GIT
	bool "Obtain package from the development GIT"

config BR2_PACKAGE_LIBPMT_CUSTOM_TARBALL
	bool "Release sources supplied as archives"
	help
	  Use the package sources from local archive

config BR2_PACKAGE_LIBPMT_RELEASE
	bool "Release archives"
	help
	  Use the package sources specified in this SDK release

endchoice

if BR2_PACKAGE_LIBPMT_CUSTOM_GIT

config BR2_PACKAGE_LIBPMT_CUSTOM_REPO_URL
	string "URL of custom repository"

config BR2_PACKAGE_LIBPMT_CUSTOM_REPO_VERSION
	string "Custom repository version"
	help
	  Revision to use in the typical format used by Git
	  E.G. a sha id, a tag, branch, ..

endif

config BR2_PACKAGE_LIBPMT_CUSTOM_TARBALL_LOCATION
	string "Name of local archive file with release"

config BR2_PACKAGE_LIBPMT_VERSION
	string
	default "libpmt-devel" if BR2_PACKAGE_LIBPMT_GIT
	default BR2_MARVELL_RELEASE_ID if BR2_PACKAGE_LIBPMT_CUSTOM_TARBALL
	default BR2_MARVELL_RELEASE_ID if BR2_PACKAGE_LIBPMT_RELEASE
	default BR2_PACKAGE_LIBPMT_CUSTOM_REPO_VERSION if BR2_PACKAGE_LIBPMT_CUSTOM_GIT

endif
```

## package/libtmc/Config.in
```kconfig
config BR2_PACKAGE_LIBTMC
	bool "libtmc"
	help
	  Task isolation support.

	  This is the userspace part of the task isolation support for
	  Linux. It requires task isolation patch applied to he
	  kernel.

	  That patch is based on the task isolation patch v15 by Chris
	  Metcalf <cmetcalf@mellanox.com> ported to kernel 4.9.x, plus
	  the update that disables timers while isolated tasks are
	  running.

if BR2_PACKAGE_LIBTMC

choice
	prompt "libtmc-version"
	default BR2_PACKAGE_LIBTMC_RELEASE

config BR2_PACKAGE_LIBTMC_CUSTOM_GIT
	bool "Custom Git repository"
	help
	  Allows to specify custom repository for the component
	  Useful for developers building out of bleeding edge sources

config BR2_PACKAGE_LIBTMC_GIT
	bool "Obtain package from the development GIT"

config BR2_PACKAGE_LIBTMC_CUSTOM_TARBALL
	bool "Release sources supplied as archives"
	help
	  Use the package sources from local archive

config BR2_PACKAGE_LIBTMC_RELEASE
	bool "Release archives"
	help
	  Use the package sources specified in this SDK release

endchoice

if BR2_PACKAGE_LIBTMC_CUSTOM_GIT

config BR2_PACKAGE_LIBTMC_CUSTOM_REPO_URL
	string "URL of custom repository"

config BR2_PACKAGE_LIBTMC_CUSTOM_REPO_VERSION
	string "Custom repository version"
	help
	  Revision to use in the typical format used by Git
	  E.G. a sha id, a tag, branch, ..

endif

config BR2_PACKAGE_LIBTMC_CUSTOM_TARBALL_LOCATION
	string "Name of local archive file with release"

config BR2_PACKAGE_LIBTMC_VERSION
	string
	default "libtmc-devel" if BR2_PACKAGE_LIBTMC_GIT
	default BR2_MARVELL_RELEASE_ID if BR2_PACKAGE_LIBTMC_CUSTOM_TARBALL
	default BR2_MARVELL_RELEASE_ID if BR2_PACKAGE_LIBTMC_RELEASE
	default BR2_PACKAGE_LIBTMC_CUSTOM_REPO_VERSION if BR2_PACKAGE_LIBTMC_CUSTOM_GIT

endif
```
