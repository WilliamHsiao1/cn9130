## boot/marvell-external-fw/extension-packages/python-pyyaml-include/Config.in
```kconfig
config BR2_PACKAGE_PYTHON_PYYAML_INCLUDE
	bool "python-pyyaml-include"
	select BR2_PACKAGE_PYTHON_PYYAML
	default y
    help

        https://pypi.org/project/pyyaml-include
```

## boot/uefi/Config.in
```kconfig
config BR2_TARGET_UEFI
	bool "UEFI"
	help
	  Enable this option if you want to build UEFI
	  Processors

if BR2_TARGET_UEFI

config BR2_TARGET_UEFI_PLATFORM
        string "Marvell platform (a80x0, t96...)"

config BR2_TARGET_UEFI_GIT
	bool "Obtain UEFI sources from GIT"

config BR2_TARGET_UEFI_DEBUG
	bool "DEBUG build-target vs RELEASE"

endif
```

## configs/.cn9130_marvell_armada_release_defconfig
```kconfig
#
# Marvell Auto-generate <.cn9130_marvell_armada_release_defconfig>
#-
BR2_MARVELL_RELEASE_ID="SDK13.26.04"
BR2_TARGET_GENERIC_ISSUE="Welcome to Buildroot Marvell"
BR2_TARGET_GENERIC_HOSTNAME="marvell"
BR2_cortex_a72=y
BR2_MARVELL_SOC_FAMILY="ARMADA"
#-
BR2_aarch64=y
BR2_SVN="svn"
BR2_OPTIMIZE_2=y
BR2_TOOLCHAIN_EXTERNAL=y
BR2_TOOLCHAIN_EXTERNAL_CUSTOM=y
BR2_TOOLCHAIN_EXTERNAL_HEADERS_4_20=y
BR2_TOOLCHAIN_EXTERNAL_CUSTOM_GLIBC=y
BR2_TOOLCHAIN_EXTERNAL_CXX=y
BR2_TOOLCHAIN_EXTERNAL_FORTRAN=y
BR2_TOOLCHAIN_EXTERNAL_OPENMP=y
BR2_TOOLCHAIN_EXTERNAL_CUSTOM_PREFIX="aarch64-none-linux-gnu"
BR2_TOOLCHAIN_EXTERNAL_BINUTILS_COPY=y
#-
BR2_TOOLCHAIN_EXTERNAL_GCC_14=y
BR2_TOOLCHAIN_EXTERNAL_INET_RPC=n
BR2_TOOLCHAIN_EXTERNAL_FIXUP_SYSROOT_SCRIPT="$(BR2_EXTERNAL_MARVELL_SDK_PATH)/board/marvell/toolchain-fixup-gcc12.sh"
#-
BR2_ARM64_PAGE_SIZE_64K=y
#-
BR2_TARGET_CFLAGS="-zmuldefs -fcommon"
BR2_TARGET_LDFLAGS="-zmuldefs -zcommon"
#
BR2_TOOLCHAIN_EXTERNAL_DOWNLOAD=y
BR2_TOOLCHAIN_EXTERNAL_URL="file://$(TOPDIR)/../toolchain/arm-gnu-toolchain-14.2.rel1-x86_64-aarch64-none-linux-gnu.tar.xz"
BR2_ADDITIONAL_TOOLCHAIN_EXTERNAL_URL="file://$(TOPDIR)/../toolchain/gcc-arm-10.3-2021.07-x86_64-arm-none-eabi.tar.xz"
#-
BR2_LINUX_KERNEL_INSTALL_TARGET=y
#
BR2_LINUX_KERNEL=y
BR2_LINUX_KERNEL_CUSTOM_TARBALL=y
BR2_LINUX_KERNEL_CUSTOM_TARBALL_LOCATION="file://$(TOPDIR)/../base-sources-$(BR2_MARVELL_RELEASE_ID)/linux/sources-linux-6.6.x-$(BR2_MARVELL_RELEASE_ID).tar.bz2"
BR2_LINUX_KERNEL_USE_CUSTOM_CONFIG=y
BR2_LINUX_KERNEL_DTS_SUPPORT=y

BR2_ROOTFS_POST_SCRIPT_ARGS="$(BR2_MARVELL_SOC_FAMILY)"

BR2_LINUX_KERNEL_CUSTOM_CONFIG_FILE="$(BR2_EXTERNAL_MARVELL_SDK_PATH)/board/marvell/marvell_v8_armada_kernel.config"

BR2_LINUX_KERNEL_VERSION_6_X=y
BR2_PACKAGE_LIBGPIOD=y
BR2_PACKAGE_LIBTRACEEVENT=y
BR2_PACKAGE_CRYPTODEV_LINUX=y
#--- Mainline packages 1 ---
BR2_TARGET_TZ_INFO=y
BR2_PACKAGE_BUSYBOX_CONFIG="$(BR2_EXTERNAL_MARVELL_SDK_PATH)/board/marvell/busybox.config"
BR2_PACKAGE_BUSYBOX_SHOW_OTHERS=y
BR2_PACKAGE_BUSYBOX_WATCHDOG=y
BR2_PACKAGE_BZIP2=y
BR2_PACKAGE_ZIP=y
BR2_PACKAGE_FIO=y
BR2_PACKAGE_MTD=y
BR2_PACKAGE_NFS_UTILS=y
BR2_PACKAGE_NFS_UTILS_NFS4=y
BR2_PACKAGE_DHCP_CLIENT=y
BR2_PACKAGE_DHCPCD=y
BR2_PACKAGE_ARPTABLES=y
BR2_PACKAGE_BRIDGE_UTILS=y
BR2_PACKAGE_ETHTOOL=y
BR2_PACKAGE_LKSCTP_TOOLS=y
BR2_PACKAGE_IPERF3=y
BR2_PACKAGE_IPTABLES=y
BR2_PACKAGE_IPUTILS=y
BR2_PACKAGE_NET_TOOLS=y
BR2_PACKAGE_TCPDUMP=y
BR2_PACKAGE_TCPDUMP_SMB=y
BR2_PACKAGE_TFTPD=y
BR2_PACKAGE_FILE=y
BR2_PACKAGE_CPULOAD=y
BR2_PACKAGE_HTOP=y
BR2_PACKAGE_KMOD=y
BR2_PACKAGE_KMOD_TOOLS=y
BR2_PACKAGE_UTIL_LINUX_BINARIES=y
BR2_PACKAGE_UTIL_LINUX_FSCK=y
BR2_PACKAGE_UTIL_LINUX_HWCLOCK=y
BR2_PACKAGE_UTIL_LINUX_KILL=y
# BR2_ENABLE_LOCALE_PURGE is not set
BR2_ROOTFS_MERGED_USR=y
BR2_PACKAGE_HOST_GENIMAGE=y
BR2_PACKAGE_HOST_MTOOLS=y
BR2_PACKAGE_PYTHON3=y
BR2_PACKAGE_PYTHON_CRYPTOGRAPHY=y
BR2_PACKAGE_HOST_PYTHON_SIX=y
BR2_PACKAGE_E2FSPROGS=y
BR2_PACKAGE_RSYNC=y
BR2_SYSTEM_BIN_SH_BASH=y
BR2_PACKAGE_DROPBEAR=y
BR2_PACKAGE_UBOOT_TOOLS=y
BR2_PACKAGE_UBOOT_TOOLS_FWPRINTENV=y
BR2_PACKAGE_PCIUTILS=y
BR2_PACKAGE_SCHEDTOOL=y
BR2_PACKAGE_LRZSZ=y
BR2_PACKAGE_IPROUTE2=y
BR2_PACKAGE_RSYSLOG=y
BR2_PACKAGE_XORG7=y
BR2_PACKAGE_BINUTILS=y
BR2_PACKAGE_BINUTILS_TARGET=y
BR2_PACKAGE_DOCKER_CLI=y
BR2_PACKAGE_DOCKER_CLI_STATIC=y
BR2_PACKAGE_DOCKER_COMPOSE=y
BR2_PACKAGE_CONTAINERD=y
BR2_PACKAGE_DOCKER_ENGINE=y
BR2_PACKAGE_DOCKER_ENGINE_DRIVER_BTRFS=y
BR2_PACKAGE_DOCKER_ENGINE_DRIVER_DEVICEMAPPER=y
BR2_PACKAGE_DOCKER_ENGINE_DRIVER_VFS=y
BR2_PACKAGE_CA_CERTIFICATES=y
BR2_PACKAGE_CGROUPFS_MOUNT=y
BR2_PACKAGE_DMIDECODE=y
BR2_PACKAGE_EFIVAR=y
BR2_PACKAGE_EFIBOOTMGR=y
BR2_PACKAGE_OPEN_LLDP=y
BR2_PACKAGE_PYTHON_SCAPY=y
#--- Keep/no-strip DEBUG-info in FINALIZE-stage for specified
# BR2_STRIP_EXCLUDE_DIRS = "dir1 dir2"
# BR2_STRIP_EXCLUDE_FILES = "file1 file2"

#--- Mainline packages 2 (BenchMark) ---
BR2_TARGET_GENERIC_GETTY_BAUDRATE_115200=y
BR2_PACKAGE_DT=y
BR2_PACKAGE_IOZONE=y
BR2_PACKAGE_LMBENCH=y
BR2_PACKAGE_NETPERF=y
BR2_PACKAGE_STRACE=y
BR2_PACKAGE_STRESS=y
BR2_PACKAGE_TRACE_CMD=y
BR2_PACKAGE_FLEX=y
BR2_PACKAGE_LIBTOOL=y
BR2_PACKAGE_MAKE=y
BR2_PACKAGE_BTRFS_PROGS=y
BR2_PACKAGE_CIFS_UTILS=y
BR2_PACKAGE_E2FSPROGS_RESIZE2FS=y
BR2_PACKAGE_MTD_DOCFDISK=y
BR2_PACKAGE_MTD_DOC_LOADBIOS=y
BR2_PACKAGE_MTD_FLASH_OTP_DUMP=y
BR2_PACKAGE_MTD_FLASH_OTP_INFO=y
BR2_PACKAGE_MTD_FLASH_OTP_LOCK=y
BR2_PACKAGE_MTD_FLASH_OTP_WRITE=y
BR2_PACKAGE_MTD_FTL_CHECK=y
BR2_PACKAGE_MTD_FTL_FORMAT=y
BR2_PACKAGE_MTD_JFFS2DUMP=y
BR2_PACKAGE_MTD_MKFSJFFS2=y
BR2_PACKAGE_MTD_MKFSUBIFS=y
BR2_PACKAGE_MTD_MTDPART=y
BR2_PACKAGE_MTD_TESTS=y
BR2_PACKAGE_MTD_FLASH_READTEST=y
BR2_PACKAGE_MTD_FLASH_SPEED=y
BR2_PACKAGE_MTD_FLASH_STRESS=y
BR2_PACKAGE_MTD_FLASH_TORTURE=y
BR2_PACKAGE_MTD_INTEGCK=y
BR2_PACKAGE_MTD_NANDBITERRS=y
BR2_PACKAGE_MTD_NANDPAGETEST=y
BR2_PACKAGE_MTD_NANDSUBPAGETEST=y
BR2_PACKAGE_XFSPROGS=y
BR2_PACKAGE_CRYPTSETUP=y
BR2_PACKAGE_DBUS=y
BR2_PACKAGE_HDPARM=y
BR2_PACKAGE_I2C_TOOLS=y
BR2_PACKAGE_LINUXCONSOLETOOLS=y
BR2_PACKAGE_LM_SENSORS=y
BR2_PACKAGE_LM_SENSORS_FANCONTROL=y
BR2_PACKAGE_LM_SENSORS_SENSORS_DETECT=y
BR2_PACKAGE_MDADM=y
BR2_PACKAGE_MEMTESTER=y
BR2_PACKAGE_NVME=y
BR2_PACKAGE_SDPARM=y
BR2_PACKAGE_SETSERIAL=n
BR2_PACKAGE_SYSSTAT=y
BR2_PACKAGE_WIPE=n
BR2_PACKAGE_PERL=y
BR2_PACKAGE_PERL_FILE_UTIL=y
BR2_PACKAGE_PERL_NET_DNS=y
BR2_PACKAGE_PERL_NET_HTTP=y
BR2_PACKAGE_PERL_XML_LIBXML=y
BR2_PACKAGE_LIBGCRYPT=y
BR2_PACKAGE_LIBOPENSSL_BIN=y
BR2_PACKAGE_LIBOPENSSL_ENGINES=y
BR2_PACKAGE_PIXMAN=y
BR2_PACKAGE_DTC=y
BR2_PACKAGE_DTC_PROGRAMS=y
BR2_PACKAGE_LIBUSB=y
BR2_PACKAGE_LIBCAP=y
BR2_PACKAGE_BC=y
BR2_PACKAGE_DHCP=y
BR2_PACKAGE_DHCP_RELAY=y
BR2_PACKAGE_EBTABLES=y
BR2_PACKAGE_IFENSLAVE=y
BR2_PACKAGE_IFTOP=y
BR2_PACKAGE_IFUPDOWN=y
BR2_PACKAGE_MII_DIAG=y
BR2_PACKAGE_NETCAT=y
BR2_PACKAGE_OPENSSH=y
BR2_PACKAGE_OPENSWAN=y
BR2_PACKAGE_PURE_FTPD=y
BR2_PACKAGE_RP_PPPOE=y
BR2_PACKAGE_TRACEROUTE=y
BR2_PACKAGE_TUNCTL=y
BR2_PACKAGE_FTOP=y
BR2_PACKAGE_PROCPS_NG=y
BR2_PACKAGE_PSMISC=y
BR2_PACKAGE_UTIL_LINUX_LOSETUP=y
BR2_PACKAGE_UTIL_LINUX_MORE=y
BR2_PACKAGE_UTIL_LINUX_MOUNT=y
BR2_PACKAGE_UTIL_LINUX_NOLOGIN=y
BR2_PACKAGE_UTIL_LINUX_NSENTER=y
BR2_PACKAGE_UTIL_LINUX_UNSHARE=y
BR2_PACKAGE_HOST_E2FSPROGS=y
BR2_PACKAGE_HOST_GENEXT2FS=y
BR2_PACKAGE_NUMACTL=y
BR2_PACKAGE_TAR=y
BR2_PACKAGE_SCREEN=y
BR2_PACKAGE_TPM2_TOOLS=y
BR2_PACKAGE_TPM2_ABRMD=y
BR2_PACKAGE_TPM2_TSS=y
BR2_PACKAGE_LIBSECCOMP=y

#--- Mainline packages 3 (Netfilter, IPSEC, tools) ---
BR2_PACKAGE_LINUXPTP=y
BR2_PACKAGE_LINUX_TOOLS_CPUPOWER=y
BR2_PACKAGE_LINUX_TOOLS_GPIO=y
BR2_PACKAGE_LINUX_TOOLS_PERF=y
BR2_PACKAGE_GDB=y
BR2_PACKAGE_GDB_SERVER=y
BR2_PACKAGE_GDB_DEBUGGER=y
BR2_PACKAGE_KEXEC=y
BR2_PACKAGE_FINDUTILS=y
BR2_PACKAGE_GAWK=y
BR2_PACKAGE_PATCH=y
BR2_PACKAGE_SED=y
BR2_PACKAGE_TREE=y
BR2_PACKAGE_DOSFSTOOLS=y
BR2_PACKAGE_DOSFSTOOLS_FSCK_FAT=y
BR2_PACKAGE_DOSFSTOOLS_MKFS_FAT=y
BR2_PACKAGE_E2FSPROGS_E4DEFRAG=y
BR2_PACKAGE_E2TOOLS=y
BR2_PACKAGE_ECRYPTFS_UTILS=y
BR2_PACKAGE_EXFAT_UTILS=y
BR2_PACKAGE_GPTFDISK=y
BR2_PACKAGE_GPTFDISK_SGDISK=y
BR2_PACKAGE_LSHW=y
BR2_PACKAGE_MINICOM=y
BR2_PACKAGE_PARTED=y
BR2_PACKAGE_POWERTOP=y
BR2_PACKAGE_PYTHON_SSL=y
BR2_PACKAGE_PYTHON_PYEXPAT=y
BR2_PACKAGE_PYTHON_ZLIB=y
BR2_PACKAGE_GNUTLS=y
BR2_PACKAGE_GNUTLS_TOOLS=y
BR2_PACKAGE_LIBGLIB2=y
BR2_PACKAGE_LIBNFSIDMAP=y
BR2_PACKAGE_LIBNETFILTER_ACCT=y
BR2_PACKAGE_LIBNETFILTER_LOG=y
BR2_PACKAGE_LIBNFTNL_JSON=y
BR2_PACKAGE_COLLECTD=y
BR2_PACKAGE_COLLECTD_CONNTRACK=y
BR2_PACKAGE_COLLECTD_IPTABLES=y
BR2_PACKAGE_BIND=y
BR2_PACKAGE_BIND_TOOLS=y
BR2_PACKAGE_CONNTRACK_TOOLS=y
BR2_PACKAGE_DHCP_SERVER=y
BR2_PACKAGE_DHCPDUMP=y
BR2_PACKAGE_DNSMASQ=y
BR2_PACKAGE_DNSMASQ_DNSSEC=y
BR2_PACKAGE_DNSMASQ_IDN=y
BR2_PACKAGE_DNSMASQ_CONNTRACK=y
BR2_PACKAGE_DRBD_UTILS=y
BR2_PACKAGE_ELFUTILS=y
BR2_PACKAGE_IPERF=y
BR2_PACKAGE_IPSEC_TOOLS_NATT=y
BR2_PACKAGE_IPSEC_TOOLS_FRAG=y
BR2_PACKAGE_IPSEC_TOOLS_DPD=y
BR2_PACKAGE_IPSEC_TOOLS_READLINE=y
BR2_PACKAGE_IPSEC_TOOLS_HYBRID=y
BR2_PACKAGE_IPSET=y
BR2_PACKAGE_IPTABLES_NFTABLES=y
BR2_PACKAGE_MROUTED=y
BR2_PACKAGE_NCFTP=y
BR2_PACKAGE_NFACCT=y
BR2_PACKAGE_NFTABLES=y
BR2_PACKAGE_NGREP=y
BR2_PACKAGE_NLOAD=y
BR2_PACKAGE_NMAP=y
BR2_PACKAGE_NMAP_NCAT=y
BR2_PACKAGE_PYTHON_PYNDIFF=y
BR2_PACKAGE_NMAP_NMAP=y
BR2_PACKAGE_NMAP_NPING=y
BR2_PACKAGE_NTP=y
BR2_PACKAGE_PPPD_FILTER=y
BR2_PACKAGE_PROXYCHAINS_NG=y
BR2_PACKAGE_QUAGGA=y
BR2_PACKAGE_QUAGGA_ZEBRA=y
BR2_PACKAGE_QUAGGA_TCP_ZEBRA=y
BR2_PACKAGE_QUAGGA_BGPD=y
BR2_PACKAGE_QUAGGA_BGP_ANNOUNCE=y
BR2_PACKAGE_QUAGGA_OSPFD=y
BR2_PACKAGE_QUAGGA_OSPF6D=y
BR2_PACKAGE_QUAGGA_RIPD=y
BR2_PACKAGE_QUAGGA_RIPNGD=y
BR2_PACKAGE_QUAGGA_PIMD=y
BR2_PACKAGE_QUAGGA_WATCHQUAGGA=y
BR2_PACKAGE_QUAGGA_VTYSH=y
BR2_PACKAGE_QUAGGA_SNMP=y
BR2_PACKAGE_SAMBA4=y
BR2_PACKAGE_STRONGSWAN=y
BR2_PACKAGE_STRONGSWAN_AF_ALG=y
BR2_PACKAGE_STUNNEL=y
BR2_PACKAGE_TCPING=y
BR2_PACKAGE_TCPREPLAY=y
BR2_PACKAGE_THTTPD=n
BR2_PACKAGE_UDPCAST=y
BR2_PACKAGE_UDPCAST_SENDER=y
BR2_PACKAGE_UDPCAST_RECEIVER=y
BR2_PACKAGE_WGET=y
BR2_PACKAGE_COREUTILS=y
BR2_PACKAGE_IOTOP=y
BR2_PACKAGE_IRQBALANCE=n
BR2_PACKAGE_UTIL_LINUX_SCHEDUTILS=y
BR2_PACKAGE_NANO=y
BR2_PACKAGE_VIM=y
BR2_PACKAGE_GPSD=y

#--- Mainline packages 4 (custom adds) ---
BR2_PACKAGE_CUNIT=y
BR2_PACKAGE_QEMU=y
BR2_PACKAGE_QEMU_SYSTEM=y
BR2_PACKAGE_QEMU_LINUX_USER=y
BR2_PACKAGE_QEMU_FDT=y
BR2_PACKAGE_ASIMCP=y
BR2_PACKAGE_RASDAEMON=y
BR2_PACKAGE_SUDO=y

#--- Mainline packages - custom adds ---


#--- Marvell packages ---
#
BR2_PACKAGE_TXCSR=y
BR2_PACKAGE_CPT_MICROCODE=y
BR2_PACKAGE_MEMUTILS=y
BR2_PACKAGE_TDM_UTILS=y
BR2_PACKAGE_LIBTMC=y
BR2_PACKAGE_GATOR=y
BR2_PACKAGE_OPTEE=n
BR2_PACKAGE_OPTEE_GIT=n
#
BR2_PACKAGE_IS_FW=y
# BR2_PACKAGE_IS_FW_GIT is not set
BR2_PACKAGE_TDM_UTILS_VOICE_TOOL=y
#
BR2_PACKAGE_LIBPMT=n
#
BR2_PACKAGE_MUSDK_MARVELL=y
BR2_PACKAGE_MUSDK_MARVELL_PP2=y
# BR2_PACKAGE_MUSDK_MARVELL_PP2_LOCK is not set
BR2_PACKAGE_MUSDK_MARVELL_NETA=y
BR2_PACKAGE_MUSDK_MARVELL_SAM=y
BR2_PACKAGE_MUSDK_MARVELL_KERNEL_PATCHES_APPLY=n
BR2_PACKAGE_MUSDK_MARVELL_KERNEL_PATCHES_LINUX_4_14=y
#
BR2_PACKAGE_MUSDK_MARVELL_CUSTOM_TARBALL=y
BR2_PACKAGE_MUSDK_MARVELL_CUSTOM_TARBALL_LOCATION="$(TOPDIR)/../base-sources-$(BR2_MARVELL_RELEASE_ID)/musdk-marvell/sources-musdk-marvell-$(BR2_MARVELL_RELEASE_ID).tar.bz2"
#
BR2_PACKAGE_DPDK=y
BR2_PACKAGE_DPDK_CUSTOM_ARCHIVE=y
BR2_PACKAGE_DPDK_CUSTOM_ARCHIVE_LOCATION="$(TOPDIR)/../base-sources-$(DPDK_RELEASE)/dpdk/sources-dpdk-23.11-$(DPDK_RELEASE).tar.bz2"
#
BR2_PACKAGE_LIBIPSEC_MB=y
BR2_PACKAGE_LIBIPSEC_MB_VERSION="SECLIB-IPSEC-2023.06.20"
#
BR2_PACKAGE_SPDK=n
#
BR2_PACKAGE_SPDK_CUSTOM_ARCHIVE=y
BR2_PACKAGE_SPDK_CUSTOM_ARCHIVE_LOCATION="$(TOPDIR)/../base-sources-$(SPDK_RELEASE)/spdk/sources-spdk-$(SPDK_RELEASE).tar.bz2"
#-
BR2_GLOBAL_PATCH_DIR="$(BR2_EXTERNAL_MARVELL_SDK_PATH)/patches $(BR2_EXTERNAL_MARVELL_SDK_PATH)/patches/armada"


#--- Boot-image fragments ---
#
BR2_TARGET_ARM_TRUSTED_FIRMWARE=y
BR2_TARGET_ARM_TRUSTED_FIRMWARE_CUSTOM_TARBALL=y
BR2_TARGET_ARM_TRUSTED_FIRMWARE_CUSTOM_TARBALL_LOCATION="file://$(TOPDIR)/../base-sources-$(BR2_MARVELL_RELEASE_ID)/arm-trusted-firmware/sources-atf-v2.8-$(BR2_MARVELL_RELEASE_ID).tar.bz2"
BR2_TARGET_ARM_TRUSTED_FIRMWARE_FIP=y
BR2_TARGET_ARM_TRUSTED_FIRMWARE_UBOOT_AS_BL33=y
BR2_TARGET_ARM_TRUSTED_FIRMWARE_ADDITIONAL_VARIABLES="WORKAROUND_CVE_2018_3639=0 USE_COHERENT_MEM=0 "
BR2_TARGET_ARM_TRUSTED_FIRMWARE_BL32_OPTEE=n
#
BR2_TARGET_BINARIES_MARVELL=y
BR2_TARGET_BINARIES_MARVELL_CUSTOM_TARBALL=y
BR2_TARGET_BINARIES_MARVELL_CUSTOM_TARBALL_LOCATION="file://$(TOPDIR)/../base-sources-$(BR2_MARVELL_RELEASE_ID)/armada-firmware/sources-armada-firmware-10.1.0-$(BR2_MARVELL_RELEASE_ID).tar.bz2"
#
BR2_TARGET_UBOOT=y
BR2_TARGET_UBOOT_CUSTOM_TARBALL=y
BR2_TARGET_UBOOT_CUSTOM_TARBALL_LOCATION="file://$(TOPDIR)/../base-sources-$(BR2_MARVELL_RELEASE_ID)/uboot/sources-uboot-2023.01-$(BR2_MARVELL_RELEASE_ID).tar.bz2"
BR2_TARGET_UBOOT_NEEDS_DTC=y
BR2_TARGET_UBOOT_FORMAT_BIN=y
#
BR2_TARGET_MV_DDR_MARVELL=y
BR2_TARGET_MV_DDR_MARVELL_CUSTOM_TARBALL=y
BR2_TARGET_MV_DDR_MARVELL_CUSTOM_TARBALL_LOCATION="file://$(TOPDIR)/../base-sources-$(BR2_MARVELL_RELEASE_ID)/mv-ddr-marvell/sources-mv_ddr-$(BR2_MARVELL_RELEASE_ID).tar.bz2"
#
#
BR2_TARGET_ARM_TRUSTED_FIRMWARE_ATF_24=y
BR2_TARGET_ARM_TRUSTED_FIRMWARE_PLATFORM="t9130"
BR2_TARGET_UBOOT_BUILD_SYSTEM_KCONFIG=y
BR2_TARGET_UBOOT_BOARD_DEFCONFIG="mvebu_db_cn91xx"
BR2_TARGET_UBOOT_CUSTOM_DTS_NAME="cn9130-db-A"
BR2_LINUX_KERNEL_INTREE_DTS_NAME="marvell/cn9130-db marvell/cn9131-db marvell/cn9132-db marvell/cn9130-crb-A marvell/cn9131-db "
BR2_PACKAGE_OPENSSL_OLD_VERSION=y

# WA: Overwrite NO to disable packages failed on GCC10 compilation
BR2_PACKAGE_MEMTESTER=n
BR2_PACKAGE_LINUX_TOOLS_CPUPOWER=n
BR2_PACKAGE_LINUX_TOOLS_GPIO=n
BR2_PACKAGE_MEMUTILS=n
BR2_PACKAGE_TDM_UTILS=n
BR2_PACKAGE_MBEDTLS=n
BR2_PACKAGE_MBEDTLS_INSTALL_SOURCES_STAGING=n

BR2_PACKAGE_ODP_PLATFORM_MUSDK=y
BR2_TARGET_UBOOT_CUSTOM_CONFIG_FIXUP=y
BR2_TARGET_UBOOT_CONFIG_FIXUP_SCRIPT_PATH="$(BR2_EXTERNAL_MARVELL_SDK_PATH)/scripts/config_uboot_fixup.sh"
BR2_TARGET_ARM_TRUSTED_FIRMWARE_ADDITIONAL_ENVIRONMENT=""
BR2_TARGET_MARVELL_EXTERNAL_FW_PLATFORM="t9130"

BR2_PACKAGE_OVERRIDE_FILE="$(TOPDIR)/../override_srcdir.mk"
```

## configs/cn9130_crb-r1p3_marvell_armada_release_defconfig
```kconfig
BR2_LINUX_KERNEL_CONFIG_FRAGMENT_FILES+=" $(BR2_EXTERNAL_MARVELL_SDK_PATH)/configs/kernel-uart16.config"
```

## package/asim/Config.in
```kconfig
config BR2_PACKAGE_HOST_ASIM
	bool "ASIM scripts"
	help
	  Scripts to run ASIM, Simulator for ARM Architecture v8 (64-bit)
	  For Marvell processors

if BR2_PACKAGE_HOST_ASIM

config BR2_ASIM_GIT
	bool "Obtain ASIM from GIT"

endif
```

## package/asimcp/Config.in
```kconfig
config BR2_PACKAGE_ASIMCP
	bool "asimcp"
	help
	  A asimcp is a program to copy files from guest to host using
	  asim special hlt $0xf000 instructions.
```

## package/build-test/Config.in
```kconfig
config BR2_PACKAGE_BUILD_TEST
	bool "build-test"
	help
	  Build test for stability testing.

if BR2_PACKAGE_BUILD_TEST

config BR2_PACKAGE_BUILD_TEST_GIT
	bool "Obtain Build test for stability testing sources from GIT"

endif
```

## package/cavium-ipfwd-offload/Config.in
```kconfig
config BR2_PACKAGE_CAVIUM_IPFWD_OFFLOAD
	bool "cavium-ipfwd-offload"
	help
	  Install the Cavium IP-forwarding offload module into the filesystem.

if BR2_PACKAGE_CAVIUM_IPFWD_OFFLOAD

config BR2_PACKAGE_CAVIUM_IPFWD_OFFLOAD_GIT
	bool "Obtain Cavium IP-forwarding offload module from GIT"

endif
```

## package/cavium-xdp-ipfwd/Config.in
```kconfig
config BR2_PACKAGE_CAVIUM_XDP_IPFWD
	bool "cavium-xdp-ipfwd"
	select BR2_PACKAGE_ZLIB
	select BR2_PACKAGE_LIBZLIB
	select BR2_PACKAGE_ELFUTILS
	select BR2_PACKAGE_CLANG
	select BR2_PACKAGE_LLVM
	select BR2_PACKAGE_LLVM_BPF
	depends on BR2_LINUX_KERNEL
	help
	  Install Marvell XDP IP-forwarding program into the
	  filesystem.

if BR2_PACKAGE_CAVIUM_XDP_IPFWD

config BR2_PACKAGE_CAVIUM_XDP_IPFWD_GIT
	bool "Obtain Cavium XDP IP-forwarding program sources from GIT"

endif
```
